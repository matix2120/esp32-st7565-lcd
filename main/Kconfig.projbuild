## main/Kconfig.projbuild
```kconfig
menu "LCD Configuration"

config PIN_NUM_MOSI
    int "MOSI pin number"
	range 0 34
	default 23
	help
		GPIO number (IOxx) for SPI MOSI.

		GPIOs 35-39 are input-only so cannot be used as outputs.

config PIN_NUM_CLK
    int "CLK pin number"
	range 0 34
	default 18
	help
		GPIO number (IOxx) for SPI CLK.

		GPIOs 35-39 are input-only so cannot be used as outputs.

config PIN_NUM_CS
    int "CS pin number"
	range 0 34
	default 5
	help
		GPIO number (IOxx) for SPI CS.

		GPIOs 35-39 are input-only so cannot be used as outputs.

config PIN_NUM_RST
    int "Reset pin number"
	range 0 34
	default 17
	help
		GPIO number (IOxx) for Reset.

		GPIOs 35-39 are input-only so cannot be used as outputs.

config PIN_NUM_DC
    int "DC pin number"
	range 0 34
	default 16
	help
		GPIO number (IOxx) for Data/Command.

		GPIOs 35-39 are input-only so cannot be used as outputs.

endmenu
```
